## boards/shields/cornedeon/Kconfig.defconfig
```kconfig
config ZMK_SPLIT
    default y

if SHIELD_CORNEDEON_LEFT
config ZMK_SPLIT_BLE_CENTRAL_PERIPHERALS
    default 1
endif

if SHIELD_CORNEDEON_DONGLE
config ZMK_SPLIT_BLE_CENTRAL_PERIPHERALS
    default 2
endif


if SHIELD_CORNEDEON_LEFT || SHIELD_CORNEDEON_DONGLE

if SHIELD_CORNEDEON_LEFT
config ZMK_KEYBOARD_NAME
    default "Cornedeon ZMK"
endif

if SHIELD_CORNEDEON_DONGLE
config ZMK_KEYBOARD_NAME
    default "Cornedeon Dongle"
endif

config ZMK_SPLIT_ROLE_CENTRAL
    default y

config BT_MAX_CONN
    default 7

config BT_MAX_PAIRED
    default 7

config ZMK_USB
    default y

endif
```
