## boards/shields/cornedeon/Kconfig.shield
```kconfig
config SHIELD_CORNEDEON_DONGLE
    def_bool $(shields_list_contains,cornedeon_dongle)

config SHIELD_CORNEDEON_LEFT_CENTRAL
    def_bool $(shields_list_contains,cornedeon_left_central)

config SHIELD_CORNEDEON_RIGHT_CENTRAL
    def_bool $(shields_list_contains,cornedeon_right_central)

config SHIELD_CORNEDEON_LEFT
    def_bool $(shields_list_contains,cornedeon_left)

config SHIELD_CORNEDEON_RIGHT
    def_bool $(shields_list_contains,cornedeon_right)
```

## config/west.yml
```yaml
manifest:
  defaults:
    revision: v0.3
  remotes:
    - name: zmkfirmware
      url-base: https://github.com/zmkfirmware
    - name: alko
      url-base: https://github.com/alko-kbd   
  projects:
    - name: zmk
      remote: zmkfirmware
      revision: main
      import: app/west.yml
    - name: prospector-zmk-module
      remote: alko
      revision: main
  self:
    path: config
```
